/**
Title:DA转换
Authors:DDH-qiu
Date:2022-4-16
Abstract:DA转换输出正弦波
**/
#include"reg51.h"
#define uint unsigned int
sbit key0=P1^0;
sbit key1=P1^1;
uint value=500;
uint flag=0;
code uint sin[256]={ 
0x80, 0x83, 0x86, 0x89, 0x8c, 0x8f, 0x92, 0x95,        
0x98, 0x9c, 0x9f, 0xa2, 0xa5, 0xa8, 0xab, 0xae,       
0xb0, 0xb3, 0xb6, 0xb9, 0xbc, 0xbf, 0xc1, 0xc4,       
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0x66, 0x69, 0x6c, 0x6f, 0x73, 0x76, 0x79, 0x7c, };//code数据量过大解决,不占用存储器空间


void delay(uint n)
{
	uint i=0,j=0;
	for(i=0;i<n;i++)
	{
		for(j=0;j<120;j++);
	}
}

void key()
{
	if(flag==0&&key0==0)
	{
		flag=1;
	}
	if(flag==1&&key0==1)
	{
		value=value+50;
		flag=0;
	}


	if(flag==0&&key1==0)
	{
		flag=1;
	}
	if(flag==1&&key1==1)
	{
		value=value-50;
		flag=0;
	}
	
}

//PWM波
// void PWM()
// {
// 	P2=0;
// 	delay(50);//占空比改变方法，改变低电平的延时
// 	P2=255;
// 	delay(value);
// }

//三角波
// void stair()
// {
// 	int i=0;
// 	for(i=0;i<255;i++)
// 	{
// 		P2=i;
// 		delay(1);
// 	}
// 	for(i=255;i>0;i--)
// 	{
// 		P2=i;
// 		delay(1);
// 	}
// }


void sinwave()
{
	uint i=0;
	for(i=0;i<255;i++)
	{
		P2=sin[i];
		delay(1);//粗略延时，精确的要使用定时器
	}
}


void main()
{
	while(1)
	{
		// PWM();//占空比可调的类方波（方波占空比各50%）
		// stair();//三角波
		sinwave();
		key();
	}
}
